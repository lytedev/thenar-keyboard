## firmware/boards/shields/thenar/Kconfig.shield
```kconfig
config SHIELD_THENAR_LEFT
    def_bool $(shields_list_contains,thenar_left)

config SHIELD_THENAR_RIGHT
    def_bool $(shields_list_contains,thenar_right)
```

## v1/zmk/boards/arm/thenar_v1/Kconfig.board
```kconfig
# SPDX-License-Identifier: MIT

config BOARD_THENAR_V1
    bool "Thenar v1 (MS88SF3 nRF52840 module)"
    depends on SOC_NRF52840_QIAA
```

## v1/zmk/boards/shields/thenar_v1/Kconfig.shield
```kconfig
config SHIELD_THENAR_V1_LEFT
    def_bool $(shields_list_contains,thenar_v1_left)

config SHIELD_THENAR_V1_RIGHT
    def_bool $(shields_list_contains,thenar_v1_right)
```
