// SPDX-License-Identifier: MIT
//
// Right half: same MCP23017 pin map as left, but the position numbers
// in default_transform (positions 6..11, 18..23, etc.) live in the
// right-side block of the keymap. ZMK's split central + peripheral
// scheme means each side has its own kscan reporting positions that
// land in the central's keymap by position number.
//
// We re-use the SAME input-gpios ordering as the left overlay - both
// PCBs are mirrored copies, so the physical wiring is symmetric and
// the firmware doesn't need to know it's the right side beyond the
// SHIELD_THENAR_V1_RIGHT kconfig flag (which sets central=n).

#include "thenar_v1.dtsi"

&physical_layout0 {
    kscan = <&kscan_direct>;
    transform = <&default_transform>;
};

&kscan_direct {
    input-gpios
        = <&mcp_a 8  (GPIO_ACTIVE_LOW | GPIO_PULL_UP)>
        , <&mcp_a 9  (GPIO_ACTIVE_LOW | GPIO_PULL_UP)>
        , <&mcp_a 10 (GPIO_ACTIVE_LOW | GPIO_PULL_UP)>
        , <&mcp_a 11 (GPIO_ACTIVE_LOW | GPIO_PULL_UP)>
        , <&mcp_a 12 (GPIO_ACTIVE_LOW | GPIO_PULL_UP)>
        , <&mcp_a 13 (GPIO_ACTIVE_LOW | GPIO_PULL_UP)>
        , <&mcp_a 14 (GPIO_ACTIVE_LOW | GPIO_PULL_UP)>
        , <&mcp_a 15 (GPIO_ACTIVE_LOW | GPIO_PULL_UP)>
        , <&mcp_a 0  (GPIO_ACTIVE_LOW | GPIO_PULL_UP)>
        , <&mcp_a 1  (GPIO_ACTIVE_LOW | GPIO_PULL_UP)>
        , <&mcp_a 2  (GPIO_ACTIVE_LOW | GPIO_PULL_UP)>
        , <&mcp_a 3  (GPIO_ACTIVE_LOW | GPIO_PULL_UP)>
        , <&mcp_a 4  (GPIO_ACTIVE_LOW | GPIO_PULL_UP)>
        , <&mcp_a 5  (GPIO_ACTIVE_LOW | GPIO_PULL_UP)>
        , <&mcp_a 6  (GPIO_ACTIVE_LOW | GPIO_PULL_UP)>
        , <&mcp_a 7  (GPIO_ACTIVE_LOW | GPIO_PULL_UP)>
        , <&mcp_b 8  (GPIO_ACTIVE_LOW | GPIO_PULL_UP)>
        , <&mcp_b 9  (GPIO_ACTIVE_LOW | GPIO_PULL_UP)>
        , <&mcp_b 10 (GPIO_ACTIVE_LOW | GPIO_PULL_UP)>
        , <&mcp_b 11 (GPIO_ACTIVE_LOW | GPIO_PULL_UP)>
        , <&mcp_b 12 (GPIO_ACTIVE_LOW | GPIO_PULL_UP)>
        , <&mcp_b 13 (GPIO_ACTIVE_LOW | GPIO_PULL_UP)>
        , <&mcp_b 14 (GPIO_ACTIVE_LOW | GPIO_PULL_UP)>
        , <&mcp_b 15 (GPIO_ACTIVE_LOW | GPIO_PULL_UP)>
        , <&mcp_b 0  (GPIO_ACTIVE_LOW | GPIO_PULL_UP)>
        , <&mcp_b 1  (GPIO_ACTIVE_LOW | GPIO_PULL_UP)>
        , <&mcp_b 2  (GPIO_ACTIVE_LOW | GPIO_PULL_UP)>
        , <&mcp_b 3  (GPIO_ACTIVE_LOW | GPIO_PULL_UP)>
        ;
};

&encoder_right {
    status = "okay";
};
